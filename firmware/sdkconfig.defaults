## firmware/sdkconfig.defaults
```kconfig
# 目标芯片
CONFIG_IDF_TARGET="esp32c3"

# Wi-Fi + BLE
CONFIG_BT_ENABLED=y
CONFIG_BT_NIMBLE_ENABLED=y
CONFIG_ESP_WIFI_SSID=""
CONFIG_ESP_WIFI_PASSWORD=""

# WebSocket + mDNS
CONFIG_ESP_WEBSOCKET_CLIENT_ENABLE_SSL=y
CONFIG_ESP_MDNS_NETWORKING_SOCKET=y

# 内存与性能（C3 单核，保守配置）
CONFIG_FREERTOS_HZ=1000
CONFIG_ESP_MAIN_TASK_STACK_SIZE=4096

# 待 ESP-IDF 编译验证，键名按实际版本微调
```
